#include <SPI.h>
#include <avr/pgmspace.h>
#include "Ucglib.h"
#include "URTouch.h"

// -= LCD INIT =-
// Arduino pins                  (UNO / Mega2560) (mega2560)
#define LCD_CS 8      // CS             8
#define LCD_RST 10    // RESET          10
#define LCD_DC 9      // D/C            9
#define LCD_SDI 11    // SDI(MOSI)      11            51
#define LCD_CLK 13    // SCK            13            52
//#define LCD_SDO 12  // SDO(MISO)      12            50

Ucglib_ILI9341_18x240x320_SWSPI ucg(LCD_CLK, LCD_SDI, LCD_DC, LCD_CS, LCD_RST);
//Ucglib_ILI9341_18x240x320_HWSPI ucg(LCD_DC, LCD_CS, LCD_RST); // HWSPI does not work in UCGLIB library
// -= LCD INIT =-

// -= TOUCH SCREEN INIT =-
// Arduino pins
#define t_SCK 3   // T_CLK
#define t_CS 4    // T_CS
#define t_DIN 5   // T_DIN  (MOSI)
#define T_DOUT 6  // T_DO   (MISO)
#define t_IRQ 7   // T_IRQ

URTouch urt(t_SCK, t_CS, t_DIN, T_DOUT, t_IRQ);

int xp_cal = 2, xm_cal = 0;   // X +/- calibration
int yp_cal = 0, ym_cal = 14;  // Y +/- calibration
// -= TOUCH SCREEN INIT =-

int x, y, xt, yt;
int mode = 1;
int ScrW = 240;
int ScrH = 320;

void cal_x(){ x += xp_cal; x -= xm_cal; }
void cal_y(){ y += yp_cal; y -= ym_cal; }
void cal_xy(){ cal_x(); cal_y(); }

// Chimbalix_Logo 64x64px
const unsigned char Chimbalix_Logo[64][64] PROGMEM = {
{0, 0, 0, 0, 0, 0, 0, 0, 0, 0, 0, 0, 0,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 0, 0}, 
{0, 0, 0, 0, 0, 0, 0, 0, 0, 0, 0, 0, 0,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 0, 0}, 
{0, 0, 0, 0, 0, 0, 0, 0, 0, 0, 0, 0, 0,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 0, 0}, 
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{0, 0, 0, 0, 0, 0, 0, 0, 0, 0, 0, 0, 0,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 0, 0}
};

void drawCenter(){
  ucg.drawLine((ScrW / 2) -110, ScrH / 2, (ScrW / 2) +110, ScrH / 2);
  ucg.drawLine(ScrW / 2, (ScrH / 2) -130, ScrW / 2, (ScrH / 2) +130);
}

void draw_image(int x, int y, int width, int height){
  //int img_size = sizeof(img[1]);
  uint8_t Buffer;

  for (int yy = 0; yy < height; yy += 1) {
    for (int xx = 0; xx < width; xx += 1) {
      Buffer = pgm_read_word(&Chimbalix_Logo[yy][xx]);

      uint8_t color_data = Buffer;
      ucg.setColor( 0, color_data, 0 );
      if ( Buffer != 0 ){
        ucg.drawPixel(xx + x, yy + y);
      }
    }
  }
}

void setup(){
  ucg.begin(UCG_FONT_MODE_TRANSPARENT);
  ucg.setFont(ucg_font_ncenR14_hr);
  ucg.clearScreen();
  //ucg.setRotate180();
  drawCenter();

  //ucg.drawString(20, 270, 0, Chimbalix_Logo[1][1]);
  ucg.drawString(20, 300, 0, "ChiArdumeg v1.0");
  draw_image((ScrW / 2 - 32), (ScrH / 2 - 32), 64, 64);

  urt.InitTouch(PORTRAIT);    // 0,1: PORTRAIT, LANDSCAPE
  urt.setPrecision(PREC_HI);  // 1-4: PREC_LOW, PREC_MEDIUM, PREC_HI, PREC_EXTREME

  ucg.setColor(80, 80, 80); ucg.drawBox(0, 0, 319, 24);
  for (uint8_t i = 1; i < 9; i++) {
    ucg.setColor(255 * (i % 2), 255 * ((i / 2) % 2), 255 * ((i / 4) % 2));
    ucg.drawBox(20 * i, 10, 10, 10);
  }
  ucg.setColor(0, 200, 0); ucg.drawBox(190, 10, 10, 10);
  ucg.setColor(0, 0, 200); ucg.drawBox(210, 10, 10, 10);
}

bool touch_delay_state = 0; uint8_t touch_delay = 50;
bool touch_state = 0;

void loop(){
  while (urt.dataAvailable()) {
    if (touch_delay_state == 0) { delay(touch_delay); touch_delay_state = 1; }

    urt.read();

    xt = urt.getX(); yt = urt.getY();

    if ( touch_state == 0 ) { x = xt; y = yt; cal_xy(); touch_state = 1; }
    else {
      if ( xt < (x+4) && xt > (x-6) ){ x = xt; y = yt; cal_xy(); }
      if ( yt < (y+6) && yt > (y-4) ){ x = xt; y = yt; cal_xy(); }
    }

    if ((x != -1) && (y != -1)) {      
      if (y > 24 && mode == 1) { ucg.drawPixel(x, y); }
      if (y > 28 && mode == 2) { ucg.drawDisc(x, y, 4, 15); }
      if (y < 24 && x < 190) {
        for (uint8_t i = 1; i < 9; i++) {
          if (y < 24 && x > 20 * i - 10 && x < 20 * i + 10) {
            ucg.setColor(255 * (i % 2), 255 * ((i / 2) % 2), 255 * ((i / 4) % 2));
            mode = 1;
          }
        }
      }
      if (y < 24 && x > 190 && x < 200) { mode = 2; }
      if (y < 24 && x > 210) {
        ucg.setColor(0, 0, 0);
        ucg.drawBox(0, 24, 240, 320);
        ucg.setColor(255, 255, 255);
        ucg.setColor(0, 0, 0);
        mode = 1;
      }
    }
  }
  touch_state = 0; touch_delay_state = 0;
}